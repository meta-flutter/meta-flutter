## conf/machine/containerarm64.conf
```bitbake
#
# Copyright (c) 2020-2023 Joel Winarske. All rights reserved.
#

require conf/machine/qemuarm64.conf

PREFERRED_PROVIDER_virtual/kernel = "linux-dummy"
KERNEL_DEVICETREE = ""

MACHINE_ESSENTIAL_EXTRA_RDEPENDS = ""
```
