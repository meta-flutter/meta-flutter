## conf/distro/include/maintainers.inc
```bitbake
RECIPE_MAINTAINER_pn-dart-sdk = "Joel Winarske <joel.winarske@linux.com>"
RECIPE_MAINTAINER_pn-depot-tools-native = "Joel Winarske <joel.winarske@linux.com>"
RECIPE_MAINTAINER_pn-sentry = "Joel Winarske <joel.winarske@linux.com>"
RECIPE_MAINTAINER_pn-flutter-engine = "Joel Winarske <joel.winarske@linux.com>"
RECIPE_MAINTAINER_pn-flutter-sdk = "Joel Winarske <joel.winarske@linux.com>"
RECIPE_MAINTAINER_pn-pdfium = "Joel Winarske <joel.winarske@linux.com>"
RECIPE_MAINTAINER_pn-rive-text = "Joel Winarske <joel.winarske@linux.com>"
RECIPE_MAINTAINER_pn-flutter-auto = "Joel Winarske <joel.winarske@linux.com>"
RECIPE_MAINTAINER_pn-ivi-homescreen = "Joel Winarske <joel.winarske@linux.com>"
RECIPE_MAINTAINER_pn-flutter-pi = "Joel Winarske <joel.winarske@linux.com>"
RECIPE_MAINTAINER_pn-flutter-drm-eglstream-backend = "Joel Winarske <joel.winarske@linux.com>"
RECIPE_MAINTAINER_pn-flutter-drm-gbm-backend = "Joel Winarske <joel.winarske@linux.com>"
RECIPE_MAINTAINER_pn-flutter-external-texture-plugin = "Joel Winarske <joel.winarske@linux.com>"
RECIPE_MAINTAINER_pn-flutter-video-player-plugin = "Joel Winarske <joel.winarske@linux.com>"
RECIPE_MAINTAINER_pn-flutter-wayland-client = "Joel Winarske <joel.winarske@linux.com>"
RECIPE_MAINTAINER_pn-flutter-wayland-so = "Joel Winarske <joel.winarske@linux.com>"
RECIPE_MAINTAINER_pn-flutter-x11-client = "Joel Winarske <joel.winarske@linux.com>"
RECIPE_MAINTAINER_pn-test-runner = "Joel Winarske <joel.winarske@linux.com>"
```

## conf/machine/containerx86-64.conf
```bitbake
#
# Copyright (c) 2020-2024 Joel Winarske
#
# SPDX-License-Identifier: MIT
#

require conf/machine/qemux86-64.conf

PREFERRED_PROVIDER_virtual/kernel = "linux-dummy"
KERNEL_DEVICETREE = ""

MACHINE_ESSENTIAL_EXTRA_RDEPENDS = ""
```
